## boards/shields/chalk/Kconfig.shield
```kconfig
config SHIELD_CHALK_DONGLE
    def_bool $(shields_list_contains,chalk_dongle)

config SHIELD_CHALK_LEFT
    def_bool $(shields_list_contains,chalk_left)

config SHIELD_CHALK_RIGHT
    def_bool $(shields_list_contains,chalk_right)
```

## config/west.yml
```yaml
manifest:
  remotes:
    - name: zmkfirmware
      url-base: https://github.com/zmkfirmware
    # Additional modules containing boards/shields/custom code can be listed here as well
    # See https://docs.zephyrproject.org/3.2.0/develop/west/manifest.html#projects
  projects:
    - name: zmk
      remote: zmkfirmware
      revision: 354cff9c36b49eee6abbb8a61e6b927539aebbf2 # main
      import: app/west.yml
  self:
    path: config
```
